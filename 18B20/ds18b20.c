#include<reg51.h>
#include<intrins.h>
#include"ds18b20.h"
sbit DQ= P2^3;               //DS18B20 信号接收端
uint te;
void delay5(uchar n)
{
 	do
 	{
 		_nop_();
 		_nop_();
 		_nop_();
 		n--;
	}
	while(n);
}

//--------------------------------------------------------//
//温度传感器DS18B20初始化
//
//---------------------------------------------------------//
void init_ds18b20(void)
{
	 DQ =1;
	 delay5(10);
	 DQ =0;                   /***************/
	 delay5(120);            /***初始化传感*/
	 DQ =1;    
	 delay5(16);
	 delay5(80);
}
//--------------------------------------------------------//
//温度传感器DS18B20初始化
//
//---------------------------------------------------------//
uchar readbyte(void)       //读取DS18B20返回的字节，
{                           //将所有字节储存在date中
	uchar i=0;
	uchar date=0;
	for (i=8;i>0;i--)
	 {
		  DQ =0;
		  delay5(1);
		  DQ =1;	
		  date>>=1;
		  if(DQ)
		  date|=0x80;
		  delay5(11);
	 }
 	return(date);
}
//--------------------------------------------------------//
//给DS18B20写入字节，用于操作传感器
//
//---------------------------------------------------------//
void writebyte(uchar dat)  
{
 uchar i=0;
 for(i=8;i>0;i--)     //总共有8个字节
	 {
	  DQ =0;                                
	  DQ =dat&0x01;   //与0x01与运算后取一位写入
	  delay5(12);	   
	  DQ = 1;	  //DQ=1进行数据处理，处理完再右移
	  dat>>=1;         //右移一位，将操作值的第二个字节写入
	  delay5(5);
	  }
}
//--------------------------------------------------------//
//读取温度
//
//---------------------------------------------------------//
uint readtemp(void)
{
	uchar a,b;
	
	float	tt;
	uint t;
			
	init_ds18b20();
	writebyte(0xCC); //跳过ROM地址查询，可直接进行温度转换
	writebyte(0x44);   //指令代码：44H，启动传感器进行温度转换
	init_ds18b20();
	writebyte(0xCC); 
	writebyte(0xBE); //指令代码：BE H，读取暂存器的9位二进制数字
	a=readbyte();
	b=readbyte();
	t=b;
	t<<=8;
	t=t|a;		  //将温度的高位与低位合并
	tt=t*0.0625; 
	t= tt*10+0.5; //对结果进行4舍5入	
	return(t);

}
